/*******************************************************************************
 *                      
 *                         Copyright (c) 2013 
 *******************************************************************************/
 /******************************************************************************
 *
 * 模块名   :    Main.h
 *
 * 模块介绍 : 
 *
 * 历史修改 :
 *
 *   历史修改记录位于文件尾
 *
 ******************************************************************************/
#include "cap.h"

/*******************************************************************************
*                             G l o b a l   D a t a                            *
*******************************************************************************/
u16 count;


/*******************************************************************************
*                               F u n c t i o n s                              *
*******************************************************************************/



/*******************************************************************************
* 函数名 : cap_init
********************************************************************************
*
* 实现功能 : 输入捕获设置，设置cap为输入捕获，一个计数值为1US，即频率为1M
*  PA0------TIM5-CH1
*
* 输入 : 
* 		 
* 
* 输出 : 
*                
* 注释 :
*
********************************************************************************/
void cap_init()
{
 #if 1
	/*1：配置引脚，使能时钟，输出*/
	 GPIO_X_CLOCK_ENABLE(GPIOA_CLOCK_BIT);
	/*2：配置相应的IO口为输出口*/
	 GPIO_Set(GPIOA,PIN0,GPIO_MODE_AF,GPIO_OTYPE_PP,GPIO_SPEED_100M,GPIO_PUPD_PD);
	 GPIO_AF_Set(GPIOA,0,2); //PB0,AF2
	/*3.1:cap相关配置*/		
	Time5_clock_enable();

	
	/*4：进行时钟配置*/
	/*4.1:配置周期*/
	
	TIM5->PSC = (TIME5_FCK/1000000)-1;//配置为1M  精度为1US
	//TIM3->ARR = 10000-1; //1S定时
	TIM5->ARR = 0XFFFFFFFF; //1MS  

	
	TIM5->CR1  |=  0<<7;//TIM5_CH1 引脚连接到 TI1 输入
	
	//TIM5->SMCR |= 4<<4;//TI1 边沿检测器 (TI1F_ED)
//	TIM5->SMCR |= 4<<0;
	
//	TIM5->EGR  |= 1<<0;//
//	TIM5->EGR  |= 1<<1;//
	
	
	TIM5->CCMR1 |= 0<<2;//无预分频器，捕获输入上每检测到一个边沿便执行捕获
	TIM5->CCMR1 |=  1<<0;//CC1 通道配置为输入， IC1 映射到 TI1 上
	
	TIM5->CCER |= 0<<1;//电路对 TIxFP1 上升沿敏感
	
	
	

	
	TIM5->CCER |= 1<<0;//使能捕获
	
	TIM5->CR1  |=  1<<0;//使能CEN
	
	TIM5->DIER |=1<<1;//使能CC1中断；
	TIM5->DIER |=1<<0;//允许更新中断；
		/*4:设置中断优先级*/
	MY_NVIC_Init(2,0,TIM5_IRQn,2);
 #else
	RCC->APB1ENR|=1<<3;   	//TIM5 时钟使能 
	RCC->AHB1ENR|=1<<0;   	//使能PORTA时钟	
	GPIO_Set(GPIOA,PIN0,GPIO_MODE_AF,GPIO_OTYPE_PP,GPIO_SPEED_100M,GPIO_PUPD_PD);//复用功能,下拉
	GPIO_AF_Set(GPIOA,0,2);	//PA0,AF2
	  
 	TIM5->ARR=0XFFFFFFFF;  		//设定计数器自动重装值   
	TIM5->PSC=89;  		//预分频器 

	TIM5->CCMR1|=1<<0;		//CC1S=01 	选择输入端 IC1映射到TI1上
 	TIM5->CCMR1|=0<<4; 		//IC1F=0000 配置输入滤波器 不滤波
 	TIM5->CCMR1|=0<<10; 	//IC1PS=00 	配置输入分频,不分频 

	TIM5->CCER|=0<<1; 		//CC1P=0	上升沿捕获
	TIM5->CCER|=1<<0; 		//CC1E=1 	允许捕获计数器的值到捕获寄存器中

	TIM5->EGR=1<<0;			//软件控制产生更新事件,使写入PSC的值立即生效,否则将会要等到定时器溢出才会生效!
	TIM5->DIER|=1<<1;   	//允许捕获1中断				
	TIM5->DIER|=1<<0;   	//允许更新中断	
	TIM5->CR1|=0x01;    	//使能定时器2
	MY_NVIC_Init(2,0,TIM5_IRQn,2);//抢占2，子优先级0，组2	   
 
 
 #endif
}

/*******************************************************************************
* 函数名 : TIM5_IRQHandler
********************************************************************************
*
* 实现功能 :  系统相关初始化
*
* 输入 : 
* 		 
* 
* 输出 : 
*                
* 注释 :
*
********************************************************************************/
//捕获状态
//[7]:0,没有成功的捕获;1,成功捕获到一次.
//[6]:0,还没捕获到低电平;1,已经捕获到低电平了.
//[5:0]:捕获低电平后溢出的次数(对于32位定时器来说,1us计数器加1,溢出时间:4294秒)
u8  TIM5CH1_CAPTURE_STA=0;	//输入捕获状态		    				
u32	TIM5CH1_CAPTURE_VAL;	//输入捕获值(TIM2/TIM5是32位)
void TIM5_IRQHandler(){ 		    
	u16 tsr;
	tsr=TIM5->SR;
 	if((TIM5CH1_CAPTURE_STA&0X80)==0)//还未成功捕获	
	{
		if(tsr&0X01)//溢出
		{	     
			if(TIM5CH1_CAPTURE_STA&0X40)//已经捕获到高电平了
			{
				if((TIM5CH1_CAPTURE_STA&0X3F)==0X3F)//高电平太长了
				{
					TIM5CH1_CAPTURE_STA|=0X80;		//标记成功捕获了一次
					TIM5CH1_CAPTURE_VAL=0XFFFFFFFF;
				}else TIM5CH1_CAPTURE_STA++;
			}	 
		}
		if(tsr&0x02)//捕获1发生捕获事件
		{	
			if(TIM5CH1_CAPTURE_STA&0X40)		//捕获到一个下降沿 		
			{	  			
				TIM5CH1_CAPTURE_STA|=0X80;		//标记成功捕获到一次高电平脉宽
			    TIM5CH1_CAPTURE_VAL=TIM5->CCR1;	//获取当前的捕获值.
	 			TIM5->CCER&=~(1<<1);			//CC1P=0 设置为上升沿捕获
			}else  								//还未开始,第一次捕获上升沿
			{
				TIM5CH1_CAPTURE_STA=0;			//清空
				TIM5CH1_CAPTURE_VAL=0;
				TIM5CH1_CAPTURE_STA|=0X40;		//标记捕获到了上升沿
				TIM5->CR1&=~(1<<0)		;    	//使能定时器2
	 			TIM5->CNT=0;					//计数器清空
	 			TIM5->CCER|=1<<1; 				//CC1P=1 设置为下降沿捕获
				TIM5->CR1|=0x01;    			//使能定时器2
			}		    
		}			     	    					   
 	}
	TIM5->SR=0;//清除中断标志位   
}







void cap_task(){
	long long temp=0;  
	if(TIM5CH1_CAPTURE_STA&0X80)		//成功捕获到了一次高电平
	{
			temp=TIM5CH1_CAPTURE_STA&0X3F; 
			temp*=0XFFFFFFFF;		 		//溢出时间总和
			temp+=TIM5CH1_CAPTURE_VAL;		//得到总的高电平时间
			printf("HIGH:%lld us\r\n",temp);//打印总的高点平时间
			TIM5CH1_CAPTURE_STA=0;			//开启下一次捕获
	}



}




/*******************************************************************************
* Modification History:
*
* |    name    |    date    |       comment
*      刘连军		2013-03-05		增加加法运算函数。
*     
*
********************************************************************************/

/* End of File: Main.c */

