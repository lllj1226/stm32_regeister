/*******************************************************************************
 *                      
 *                         Copyright (c) 2013 
 *******************************************************************************/
 /******************************************************************************
 *
 * 模块名   :    Main.h
 *
 * 模块介绍 : 
 *
 * 历史修改 :
 *
 *   历史修改记录位于文件尾
 *
 ******************************************************************************/
#include "pwm.h"


/*******************************************************************************
*                             G l o b a l   D a t a                            *
*******************************************************************************/



/*******************************************************************************
*                               F u n c t i o n s                              *
*******************************************************************************/



/*******************************************************************************
* 函数名 : pwm_init
********************************************************************************
*
* 实现功能 : pwm初始化
*
* 输入 : 
* 		 
* 
* 输出 : 
*                
* 注释 :
*
********************************************************************************/
void pwm_init()
{
	#if 0  /*2个IO口的两张配置方法*/
		/*1：配置引脚，使能时钟，输出*/
		 GPIO_X_CLOCK_ENABLE(GPIOB_CLOCK_BIT);
		/*2：配置相应的IO口为输出口*/
		 GPIO_Set(GPIOB,PIN1,GPIO_MODE_AF,GPIO_OTYPE_PP,GPIO_SPEED_100M,GPIO_PUPD_PU);
		 GPIO_AF_Set(GPIOB,1,3); //PB0,AF3
		/*3.1:pwm相关配置*/		
		Time8_clock_enable();
		
		/*3.2:配置周期*/
		TIM8->PSC = (TIME8_FCK/10000)-1;
		//TIM3->ARR = 10000-1; //1S定时
		TIM8->ARR = 100-1; //1MS  fck = 1KHZ
		
		TIM8->CCR3 =10;
		/*PWM模式配置*/
		TIM8->CCMR2 |=6<<4;//CH3配置为PWM1模式
		TIM8->CCMR2 |=1<<3;//CH3预装使能
		
			/*使能GPIO输出*/
		TIM8->CCER |= 1<<10;//低电平有效
		TIM8->CCER |= 1<<8;//低电平有效
		TIM8->CCER |= 1<<9;
		TIM8->BDTR |= 1<<15;
		
		 /*3.3：开启定时器*/	
		TIM8->CR1 |= 1<<7;//使能自动重装	
		TIM8->CR1 |= 1;
	#else
		/*1：配置引脚，使能时钟，输出*/
		 GPIO_X_CLOCK_ENABLE(GPIOB_CLOCK_BIT);
		/*2：配置相应的IO口为输出口*/
		 GPIO_Set(GPIOB,PIN0,GPIO_MODE_AF,GPIO_OTYPE_PP,GPIO_SPEED_100M,GPIO_PUPD_PU);
		 GPIO_AF_Set(GPIOB,0,3); //PB0,AF3
		/*3.1:pwm相关配置*/		
		Time8_clock_enable();
		
		/*3.2:配置周期*/
		TIM8->PSC = (TIME8_FCK/10000)-1;
		//TIM3->ARR = 10000-1; //1S定时
		TIM8->ARR = 100-1; //1MS  fck = 1KHZ
		
		TIM8->CCR2 =10;
		/*PWM模式配置*/
		TIM8->CCMR1 |=6<<12;//CH3配置为PWM1模式
		TIM8->CCMR1 |=1<<11;//CH3预装使能
		
			/*使能GPIO输出*/
		TIM8->CCER |= 1<<6;//互补输出使能，注意如果没有配置该为无输出
		TIM8->CCER |= 1<<5;//低电平有效
		TIM8->CCER |= 1<<4;//输出使能
		TIM8->BDTR |= 1<<15;//高级定时器需要使能全局输出
		
		 /*3.3：开启定时器*/	
		TIM8->CR1 |= 1<<7;//使能自动重装	
		TIM8->CR1 |= 1;
	
	
	#endif

	
}

/*******************************************************************************
* 函数名 : pwm_task
********************************************************************************
*
* 实现功能 : 利用pwm实现led的控制
*
* 输入 : 
* 		 
* 
* 输出 : 
*                
* 注释 :
*
********************************************************************************/
void pwm_task(void){
	 
	 static u8 ctn_val = 0;
	 static u8 increase_flag = 0;//向上增长
	 if(increase_flag == 0)
	 {
		  if(ctn_val < 99)
		  {
		     ctn_val++;
		  }
		  else
		  {
		     increase_flag = 1;
		  }
	 
	 }else{
	 
	 	  if(ctn_val > 0)
		  {
		     ctn_val--;
		  }
		  else
		  {
		     increase_flag = 0;
		  }
	 }
	
		
     TIM8->CCR2 = ctn_val;
}






/*******************************************************************************
* Modification History:
*
* |    name    |    date    |       comment
*      刘连军		2013-03-05		增加加法运算函数。
*     
*
********************************************************************************/

/* End of File: Main.c */

