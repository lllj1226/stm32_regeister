/*******************************************************************************
 *                      
 *                         Copyright (c) 2013 
 *******************************************************************************/
 /******************************************************************************
 *
 * 模块名   :    Main.h
 *
 * 模块介绍 : 
 *
 * 历史修改 :
 *
 *   历史修改记录位于文件尾
 *
 ******************************************************************************/
#include "stdio.h"
#include "key.h"
#include "lcd.h"
/*******************************************************************************
*                             G l o b a l   D a t a                            *
*******************************************************************************/



/*******************************************************************************
*                               F u n c t i o n s                              *
*******************************************************************************/
static u8 pre_key;
static u8 key_num;

static u8 gb_Key;
/*******************************************************************************
* 函数名 : Init_MCU
********************************************************************************
*
* 实现功能 : MCU相关初始化
*
* 输入 : 
* 		 
* 
* 输出 : 
*                
* 注释 :
*
********************************************************************************/
void key_init()
{
    RCC->AHB1ENR|=1<<0;     //使能PORTA时钟 
	RCC->AHB1ENR|=1<<2;     //使能PORTC时钟 
	RCC->AHB1ENR|=1<<7;     //使能PORTH时钟
	GPIO_Set(GPIOA,PIN0,GPIO_MODE_IN,0,0,GPIO_PUPD_PD); 			//PA0设置为下拉输入 
	GPIO_Set(GPIOC,PIN13,GPIO_MODE_IN,0,0,GPIO_PUPD_PU); 			//PC13设置为上拉输入 
	GPIO_Set(GPIOH,PIN2|PIN3,GPIO_MODE_IN,0,0,GPIO_PUPD_PU);		//PH2/3设置上拉输入  
}



u8 key_get_num(){
	u8 key_val = KEY_NO_KEY;
	
	if(KEY0 == 0){		
	  key_val = KEY_0;		
	}else if(KEY1 == 0){		
	  key_val = KEY_1;			
	}else if(KEY2== 0){
	  key_val = KEY_2;	
	}else if(WK_UP == 1){
	  key_val = KEY_3;	
	}	
	return key_val;
}





u8 get_gb_key(){
	
	u8 temp_key; 
	temp_key = gb_Key;
    gb_Key = KEY_NO_KEY;	
	return temp_key;
}


/*******************************************************************************
* 函数名 : key_task
********************************************************************************
*
* 实现功能 : 主函数
*
* 输入 : 
* 		 
* 
* 输出 : 
*                
* 注释 :
*
********************************************************************************/
void key_task()
{
    static u8 count = 0;//防抖
	u8 key;
	static u8 key_state = 0;
	
	
		/*如果有按键按下*/
	if(key_get_num() != KEY_NO_KEY){
		key_num = key_get_num();		
		if((key_num != pre_key)||(key_state == 1)){
			pre_key = key_num;
			count = 0;
			key =  KEY_NO_KEY;
		}else{
		    count++;
			key =  KEY_NO_KEY;
		   if(count > 5){
			 count = 0;  
			 key = key_num;//获取到了按键
			 key_state = 1;
			 gb_Key = key;
			#if 0
			 gb_Key +=0x30;
			 LCD_ShowString(100,440,220,132,32,&gb_Key);
		    #endif
		   }
		}
	
	}else{
		key =  KEY_NO_KEY;
	    pre_key = KEY_NO_KEY;
		count = 0;
		key_state = 0;
	}
	
}

/*******************************************************************************
* Modification History:
*
* |    name    |    date    |       comment
*      刘连军		2013-03-05		增加加法运算函数。
*     
*
********************************************************************************/

/* End of File: Main.c */

